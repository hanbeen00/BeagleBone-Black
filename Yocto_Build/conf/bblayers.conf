## Yocto_Build/conf/bblayers.conf
```bitbake
# POKY_BBLAYERS_CONF_VERSION is increased each time build/conf/bblayers.conf
# changes incompatibly
POKY_BBLAYERS_CONF_VERSION = "2"

BBPATH = "${TOPDIR}"
BBFILES ?= ""

BBLAYERS ?= " \
  /home/iam/yocto/poky/meta \
  /home/iam/yocto/poky/meta-poky \
  /home/iam/yocto/poky/meta-yocto-bsp \
  /home/iam/yocto/meta-arm/meta-arm-toolchain \
  /home/iam/yocto/meta-arm/meta-arm \
  /home/iam/yocto/meta-arm/meta-arm-bsp \
  /home/iam/yocto/meta-openembedded/meta-filesystems \
  /home/iam/yocto/meta-openembedded/meta-gnome \
  /home/iam/yocto/meta-openembedded/meta-initramfs \
  /home/iam/yocto/meta-openembedded/meta-multimedia \
  /home/iam/yocto/meta-openembedded/meta-networking \
  /home/iam/yocto/meta-openembedded/meta-oe \
  /home/iam/yocto/meta-openembedded/meta-perl \
  /home/iam/yocto/meta-openembedded/meta-python \
  /home/iam/yocto/meta-openembedded/meta-webserver \
  /home/iam/yocto/meta-openembedded/meta-xfce \
  /home/iam/yocto/meta-arm/meta-atp \
  /home/iam/yocto/meta-arm/meta-gem5 \
  /home/iam/yocto/meta-ti/meta-ti-bsp \
  /home/iam/yocto/meta-ti/meta-ti-extras \
  "
```
